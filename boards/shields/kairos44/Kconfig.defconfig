## boards/shields/kairos44/Kconfig.defconfig
```kconfig
if SHIELD_KAIROS44_LEFT

config ZMK_KEYBOARD_NAME
    default "Kairos44"

config ZMK_SPLIT_ROLE_CENTRAL
    default y

endif

if SHIELD_KAIROS44_LEFT || SHIELD_KAIROS44_RIGHT

config ZMK_SPLIT
    default y

endif
```

## boards/shields/kairos44/Kconfig.shield
```kconfig
config SHIELD_KAIROS44_LEFT
    def_bool $(shields_list_contains,kairos44_left)

config SHIELD_KAIROS44_RIGHT
    def_bool $(shields_list_contains,kairos44_right)
```

## boards/shields/kairos44_trackpad/Kconfig.shield
```kconfig
config SHIELD_KAIROS44_TRACKPAD
    def_bool $(shields_list_contains,kairos44_trackpad)
    depends on SHIELD_KAIROS44_RIGHT
```

## boards/shields/kairos44_trackpad_receiver/Kconfig.shield
```kconfig
config SHIELD_KAIROS44_TRACKPAD_RECEIVER
    def_bool $(shields_list_contains,kairos44_trackpad_receiver)
    depends on SHIELD_KAIROS44_LEFT
```

## config/west.yml
```yaml
manifest:
  remotes:
    - name: zmkfirmware
      url-base: https://github.com/zmkfirmware
    - name: petejohanson
      url-base: https://github.com/petejohanson
    # Additional modules containing boards/shields/custom code can be listed here as well
    # See https://docs.zephyrproject.org/3.2.0/develop/west/manifest.html#projects
  projects:
    - name: zmk
      remote: zmkfirmware
      revision: edf5c0814fd3ea202e43aad2d68fd32e882a518c
      import: app/west.yml
    - name: cirque-input-module
      remote: petejohanson
      revision: 0de55f36bc720b5be3d8880dc856d4d78baf5214
  self:
    path: config
```

## zephyr/Kconfig
```kconfig
config KAIROS44_STATUS_DISPLAY
    bool "Kairos44 dual-half status display"
    depends on ZMK_DISPLAY && ZMK_SPLIT_ROLE_CENTRAL
    depends on SHIELD_NICE_VIEW && SHIELD_KAIROS44_TRACKPAD_RECEIVER
    select LV_USE_LABEL
    select LV_USE_CANVAS
    select LV_FONT_UNSCII_8

config KAIROS44_HOST_TELEMETRY
    bool "Kairos44 USB host telemetry"
    depends on ZMK_USB && ZMK_SPLIT_ROLE_CENTRAL
    depends on SHIELD_KAIROS44_TRACKPAD_RECEIVER
    select USB_DEVICE_HID
    help
      Adds a second USB HID interface that reports the active layers, modifiers, lock state and
      output to the host. Needs CONFIG_USB_HID_DEVICE_COUNT=2. See docs/kairos44-host-telemetry.md.

config KAIROS44_HOST_TELEMETRY_COALESCE_MS
    int "Delay before sending a changed state, in milliseconds"
    depends on KAIROS44_HOST_TELEMETRY
    default 20
    range 5 200

config KAIROS44_HOST_TELEMETRY_INIT_PRIORITY
    int "Init priority of the telemetry HID device"
    depends on KAIROS44_HOST_TELEMETRY
    default 96
    help
      Must be above ZMK_USB_HID_INIT_PRIORITY (95), so ZMK's keyboard keeps the first interface.

config KAIROS44_HOST_TELEMETRY_DEBUG_STAGE
    int "Bisect aid: 0 full, 1 USB interface only, 2 listeners without sending"
    depends on KAIROS44_HOST_TELEMETRY
    default 0
    range 0 2
```
