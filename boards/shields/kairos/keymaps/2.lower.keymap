navigation_layer {
  label = "NAVIGATION";
  display-name = "Navigate";
  bindings = <
// -----------------------------------------------------------------------------------------
// |  DELETE |       |          |      ↑   |           | PAGE_UP   | █ | MSWHL UP   | MSSCR LEFT   |      ↑       | MSSCR RIGHT   |      |      |
  &kp DELETE                      UP_ARROW               PAGE_UP        &msc SCRL_UP &msc SCRL_LEFT &mmv MOVE_UP   &msc SCRL_RIGHT &none  &none
// |  TAB    |       |   ←      |      ↓   |  →        | PAGE_DOWN | █ | MSWHL DN   |       ←      |      ↓       |     →         |      |      |
  &trans              LEFT_ARROW DOWN_ARROW RIGHT_ARROW  PAGE_DOWN      &msc SCRL_DOWN &mmv MOVE_LEFT &mmv MOVE_DOWN &mmv MOVE_RIGHT &none &none
// | BASE    |       |          |          |  HOME     |  END      | █ |            | LEFT BTN     |  MIDDLE BTN  |  RIGHT BTN    |      |      |
  &to 0       &none                           HOME        END            &none       &mkp LCLK       &mkp MCLK      &mkp RCLK     &none  &none
//                           |  ▼            |  ▼           | ▼    | █ | ▼    |  ▼    | ▼ |
                                           &trans         &trans         &trans     &trans &trans &trans
  >;
};
