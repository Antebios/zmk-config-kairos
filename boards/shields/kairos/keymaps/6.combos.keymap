base_layer {
  label = "MIRROR";
  display-name = "Mirror";
  bindings = <
// -----------------------------------------------------------------------------------------
// |   Y   |  U   |  I  |  O  |    P    | EQUAL      |  █  |  BSPC  |    Q   |  W  |  E  |  R   |  T  |
     &none  &none  &none &none  &none     &none       &none  &none   &none    &none &none  &none
// |   H   |  J   |  K  |  L  |   ; :   |  ' "       |  █  |  TAB   |   A    |  S  |  D  |   F  |  G  |
     &none  &none  &none &none  &none     &none       &none  &none   &none    &none &none  &none
// |   N   |  M   | ,<  | .>  |   /?    |  \|        |  █  |  SHFT  |   Z    |  X  |  C  |  V   |  B  |
     &none  &none  &none &none  &none     &none       &none  &none   &none    &none &none  &none
//                | Lower     | Raise   |  SPC       |  █  |  ENT   |   ↓    |  ↑  |
                   tdLower()  tdRaise() tdLeftSpace()     &kp ENTER tdDown()  tdUp()
  >;
};
