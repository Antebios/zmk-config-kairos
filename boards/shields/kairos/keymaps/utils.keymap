utils_layer {
    label = "UTILS";
    display-name = "UTILS";

    bindings = <
    //╭─────────────────┬─────────────────┬─────────────────┬─────────────────┬──────────────────┬──────────────────╮  ╭───────┬───────┬───────┬───────┬───────┬───────╮
        &bt BT_PRV      &bt BT_CLR_ALL    &bt BT_NXT        &none             &none              &none         &none   &none  &none  &none  &none   &none
    //├─────────────────┼─────────────────┼─────────────────┼─────────────────┼──────────────────┼──────────────────┤  ├───────┼───────┼───────┼───────┼───────┼───────┤
        &none          &rgb_ug RGB_TOG  &rgb_ug RGB_HUI  &rgb_ug RGB_SAI  &rgb_ug RGB_BRI  &rgb_ug RGB_SPI     &none   &none  &none  &none  &none   &none
    //├─────────────────┼─────────────────┼─────────────────┼─────────────────┼──────────────────┼──────────────────┤  ├───────┼───────┼───────┼───────┼───────┼───────┤
        &to BASE       &rgb_ug RGB_EFF  &rgb_ug RGB_HUD  &rgb_ug RGB_SAD  &rgb_ug RGB_BRD  &rgb_ug RGB_SPD     &none   &none  &none  &none  &none   &none
    //╰─────────────────┴─────────────────┴─────────────────┼─────────────────┼──────────────────┼──────────────────┤  ├───────┼───────┼───────┼───────┴───────┴───────╯
                                                                &trans        &trans            &trans         &trans &trans &trans
    //                                                      ╰────────────┴──────────────────┴──────────────────╯  ╰───────┴───────┴───────╯
    >;
};