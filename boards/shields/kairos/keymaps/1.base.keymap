base_layer {
  label = "BASE";
  display-name = "Base";
  bindings = <
// -----------------------------------------------------------------------------------------
// |  BSPC |   Q   |   W  |  E  |   R  |  T  |     |  Y  |  U   |  I  |  O  |   P  | EQUAL    |
  &kp BSPC   &kp Q  &kp W &kp E &kp R &kp T       &kp Y &kp U  &kp I &kp O  &kp P    &kp EQUAL
// |  TAB  |    A  |   S  |  D  |   F  |  G  |     |  H  |  J   |  K  |  L  |  ; : |  ' "   |
  &kp TAB HRML( A,     S,    D,     F)  &kp G     &kp H HRMR(J,    K,    L,   SEMI)  &kp SQT
    // &kp LCTRL &kp A &kp S &kp D &kp F &kp G    &kp H &kp J &kp K &kp L &kp SEMI  &kp SQT
// | SHFT  |  Z    |  X   |  C  |  V   |  B  |     |  N  |  M   |  ,<  |  .>  |  /?  |  \|  |
  &kp LSHFT &kp Z &kp X  &kp C &kp V  &kp B       &kp N &kp M  &kp COMMA &kp DOT &kp FSLH &kp BACKSLASH
//               | Lower  | Raise  |  SPC    |    |  ENT |  ↑   |  ↓   |
             &slmo_nav 1 1  &mo 3   &kp SPACE    &kp RET  &mo 3  &mo 4
  >;
};
