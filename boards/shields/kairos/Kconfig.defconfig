## boards/shields/kairos/Kconfig.defconfig
```kconfig
if SHIELD_KAIROS_LEFT

config ZMK_KEYBOARD_NAME
    default "Kairos"

config ZMK_SPLIT_ROLE_CENTRAL
    default y

endif

if SHIELD_KAIROS_LEFT || SHIELD_KAIROS_RIGHT

config ZMK_SPLIT
    default y

endif
```

## boards/shields/kairos/Kconfig.shield
```kconfig
# Copyright (c) 2020 Pete Johanson
# SPDX-License-Identifier: MIT

config SHIELD_KAIROS_LEFT
    def_bool $(shields_list_contains,kairos_left)

config SHIELD_KAIROS_RIGHT
    def_bool $(shields_list_contains,kairos_right)
```
