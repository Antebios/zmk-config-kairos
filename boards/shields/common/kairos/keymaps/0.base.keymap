base_layer {
  label = "BASE";
  display-name = "Base";
  bindings = <
// -----------------------------------------------------------------------------------------
// |  BSPC |   Q   |   W  |  E  |   R  |  T  |  █  |  Y  |  U   |  I  |  O  |   P  | EQUAL    |
  &kp BSPC   &kp Q  &kp W &kp E &kp R &kp T         &kp Y &kp U  &kp I &kp O  &kp P    &td_equal
// |  TAB  |    A  |   S  |  D  |   F  |  G  |  █  |  H  |  J   |  K  |  L  |  ; : |  ' "     |
  &kp TAB HRML( A,     S,    D,     F)  &kp G       &kp H HRMR(J,    K,    L)   SEMITD()  &td_quote
// | SHFT  |  Z    |  X   |  C  |  V   |  B  |  █  |  N  |  M   | ,<  | .>  |  /?  |  \|      |
  ASTD()  &kp Z &kp X  &kp C &kp V  &kp B           &kp N &kp M  &td_comma &td_period &td_fslash &td_bslash
//               | Lower  | Raise  |  SPC    |  █  |  ENT |  ↓   |  ↑   |
             tdLower()  tdRaise() tdLeftSpace()     &kp ENTER tdDown()  tdUp()
  KAIROS_EXTRA_BASE
  >;
};
