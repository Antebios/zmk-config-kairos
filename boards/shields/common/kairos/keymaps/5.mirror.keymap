mirror_layer {
  label = "MIRROR";
  display-name = "Mirror";
  bindings = <
// -----------------------------------------------------------------------------------------
// |   Y   |  U   |  I  |  O  |    P    | EQUAL      |  █  |  BSPC  |    Q   |  W  |  E  |  R   |  T  |
   &kp Y &kp U  &kp I &kp O  &kp P    &td_equal           &kp BSPC   &kp Q  &kp W &kp E &kp R  &kp T
// |   H   |  J   |  K  |  L  |   ; :   |  ' "       |  █  |  TAB   |   A    |  S  |  D  |   F  |  G  |
   &kp H HRMR(J,    K,    L)   SEMITD()  &td_quote        &kp TAB HRML( A,      S,    D,     F) &kp G
// |   N   |  M   | ,<  | .>  |   /?    |  \|        |  █  |  SHFT  |   Z    |  X  |  C  |  V   |  B  |
   &kp N   &kp M  &td_comma &td_period &td_fslash &td_bslash  ASTD()  &kp Z &kp X  &kp C &kp V &kp B
//                | Lower     | Raise   |  SPC       |  █  |  ENT   |   ↓    |  ↑  |
                   tdLower()  tdRaise() tdLeftSpace()     &kp ENTER tdDown()  tdUp()
   KAIROS_EXTRA_KEYS
  >;
};
