utils_layer {
  label = "UTILS";
  display-name = "Utils";
  bindings = <
//╭───────────────┬─────────────────┬─────────────────┬─────────────────┬──────────────────┬───────────────────╮  ╭──────────────────┬──────────────────┬──────────────────┬──────────────┬──────────────┬───────────────╮
    &bt BT_SEL 0    &bt BT_PRV       &bt BT_NXT        &bt BT_CLR_ALL    &ext_power EP_OFF  &ext_power EP_ON       &ext_power EP_ON   &ext_power EP_OFF  &rgb_ug RGB_TOG    &to NAVIGATION &kp C_BRI_UP   &kp C_VOL_UP
//├───────────────┼─────────────────┼─────────────────┼─────────────────┼──────────────────┼───────────────────┤  ├──────────────────┼──────────────────┼──────────────────┼──────────────┼──────────────┼───────────────┤
    &bt BT_SEL 1    &rgb_ug RGB_TOG  &rgb_ug RGB_HUI   &rgb_ug RGB_SAI   &rgb_ug RGB_BRI    &rgb_ug RGB_SPI        &rgb_ug RGB_TOG    &to FUNCTIONS      &to SYMBOL_KP     &sl NAVIGATION &kp C_BRI_DN   &kp C_VOL_DN
//├───────────────┼─────────────────┼─────────────────┼─────────────────┼──────────────────┼───────────────────┤  ├──────────────────┼──────────────────┼──────────────────┼──────────────┼──────────────┼───────────────┤
    &to BASE        &rgb_ug RGB_EFF  &rgb_ug RGB_HUD   &rgb_ug RGB_SAD   &rgb_ug RGB_BRD    &rgb_ug RGB_SPD        &to MIRROR         &kp C_PREV         &kp C_PLAY_PAUSE   &kp C_NEXT     &to COMBOS     &kp C_MUTE
//╰───────────────┴─────────────────┴─────────────────┼─────────────────┼──────────────────┼───────────────────┤  ├──────────────────┼──────────────────┼──────────────────┼──────────────┴──────────────┴───────────────╯
                                                            &trans       &trans             &trans                 &trans             &trans             &trans
//                                                    ╰─────────────────┴──────────────────┴──────────────────╯   ╰──────────────────┴──────────────────┴──────────────────╯
    KAIROS_EXTRA_KEYS
  >;
};