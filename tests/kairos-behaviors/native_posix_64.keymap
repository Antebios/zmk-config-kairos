#include <dt-bindings/zmk/keys.h>
#include <dt-bindings/zmk/kscan_mock.h>
#include <behaviors.dtsi>
#include "../../boards/shields/common/kairos/helpers/keys.keymap"
#include <behaviors/mouse_keys.dtsi>
#include <dt-bindings/zmk/pointing.h>
#include <input/processors/scaler.dtsi>
#include <input/processors/transform.dtsi>
#include <input/processors/code_mapper.dtsi>
#include <dt-bindings/zmk/input_transform.h>
#define KAIROS_TRACKPAD_NAV
#include "../../boards/shields/common/kairos/helpers/layers.keymap"
#include "../../boards/shields/common/kairos/helpers/combos_include.keymap"
#include "../../boards/shields/common/kairos/helpers/macros_include.keymap"
#include "../../boards/shields/common/kairos/helpers/timings.keymap"

#define TEST_EXTRA &trans &trans &trans &trans &trans &trans &trans &trans
#define TEST_LAYER(KEY) &kp KEY &trans &trans &trans &trans &trans &trans &trans TEST_EXTRA
#define TEST_PAD(NAME, VALUE) \
    NAME: NAME { \
        compatible = "zmk,behavior-macro"; \
        #binding-cells = <0>; \
        tap-ms = <20>; \
        wait-ms = <0>; \
        bindings = <&test_pad_motion VALUE>; \
    };

/ {
    behaviors {
        #include "../../boards/shields/common/kairos/helpers/tap_dance.keymap"

        test_pad_motion: test_pad_motion {
            compatible = "zmk,behavior-input-two-axis";
            #binding-cells = <1>;
            x-input-code = <INPUT_REL_X>;
            y-input-code = <INPUT_REL_Y>;
            trigger-period-ms = <16>;
            time-to-max-speed-ms = <0>;
            acceleration-exponent = <0>;
        };
    };

    macros {
        TEST_PAD(test_pad_up, MOVE_Y(-1024))
        TEST_PAD(test_pad_down, MOVE_Y(1024))
        TEST_PAD(test_pad_left, MOVE_X(-1024))
        TEST_PAD(test_pad_right, MOVE_X(1024))
    };

    test_pad_listener {
        compatible = "zmk,input-listener";
        device = <&test_pad_motion>;
        scroll {
            layers = <POINTER_SCROLL POINTER_EXTRA_SCROLL>;
            input-processors = <&zip_xy_scaler 1 16
                                &zip_xy_transform INPUT_TRANSFORM_Y_INVERT
                                &zip_xy_to_scroll_mapper>;
        };
        precision {
            layers = <POINTER_PRECISION POINTER_HOLD_PRECISION POINTER_EXTRA_PRECISION>;
            input-processors = <&zip_xy_scaler 1 4>;
        };
        fast {
            layers = <POINTER_FAST>;
            input-processors = <&zip_xy_scaler 2 1>;
        };
    };

    combos {
        compatible = "zmk,combos";
        COMBO(test_base, &kp Q, 0 1, COMBO_BASE)
        COMBO(test_nav, &kp R, 0 1, COMBO_NAV)
        COMBO(test_combos, &kp S, 0 1, COMBO_COMBOS)
        COMBO_ALL(test_reset, &to BASE, 2 3 7)
    };

    keymap {
        compatible = "zmk,keymap";
        base {
            bindings = <&kp B &ht LSHIFT F tdLower() tdRaise()
                        tdDown() tdUp() &kp ENTER tdLeftSpace()
                        &test_pad_up &test_pad_down &test_pad_left &test_pad_right
                        &pointer_thumb POINTER_EXTRA_SCROLL ENTER
                        &pointer_thumb POINTER_EXTRA_PRECISION SPACE ASTD() &kp MINUS>;
        };
        navigation {
            bindings = <&kp C &pointer_scroll POINTER_SCROLL LALT &trans &trans
                        &mo COMBOS &nav_scroll SCRL_UP MOVE_Y(64) &to UTILS
                        &pointer_cycle_fast POINTER_HOLD_PRECISION 0 TEST_EXTRA>;
        };
        functions {
            bindings = <&kp D &trans &trans &trans &trans
                        &nav_scroll SCRL_DOWN MOVE_Y(-64) &trans &trans TEST_EXTRA>;
        };
        symbols { bindings = <TEST_LAYER(E)>; };
        utils {
            bindings = <&kp G &trans &trans &trans
                        &trans &trans &sl NAVIGATION &to BASE TEST_EXTRA>;
        };
        mirror { bindings = <TEST_LAYER(H)>; };
        combos { bindings = <TEST_LAYER(I)>; };
    };
};

#define TEST_POINTER_KEYS(KEY) &kp KEY &trans &trans &trans &trans &trans &trans
#define TEST_POINTER_pointer_fast_layer &trans &trans &trans &trans &trans &trans &trans
#define TEST_POINTER_pointer_precision_layer TEST_POINTER_pointer_fast_layer
#define TEST_POINTER_pointer_hold_precision_layer TEST_POINTER_pointer_fast_layer
#define TEST_POINTER_pointer_scroll_layer TEST_POINTER_pointer_fast_layer
#define TEST_POINTER_pointer_extra_precision_layer TEST_POINTER_pointer_fast_layer
#define TEST_POINTER_pointer_extra_scroll_layer TEST_POINTER_pointer_fast_layer
#define TEST_POINTER_pointer_base_layer TEST_POINTER_KEYS(B)
#define TEST_POINTER_pointer_nav_scroll_layer TEST_POINTER_KEYS(C)
#define TEST_POINTER_pointer_nav_fast_layer TEST_POINTER_KEYS(J)
#define TEST_POINTER_pointer_nav_precision_layer TEST_POINTER_KEYS(K)
#define TEST_POINTER_pointer_functions_layer TEST_POINTER_KEYS(D)
#define TEST_POINTER_pointer_symbols_layer TEST_POINTER_KEYS(E)
#define TEST_POINTER_pointer_utils_layer TEST_POINTER_KEYS(G)
#define TEST_POINTER_pointer_mirror_layer TEST_POINTER_KEYS(H)
#define TEST_POINTER_pointer_combos_layer TEST_POINTER_KEYS(I)
#define POINTER_LAYER(NAME, TITLE, NEXT) NAME { label = TITLE; bindings = <TEST_POINTER_##NAME NEXT TEST_EXTRA>; };
#include "../../boards/shields/common/kairos/helpers/pointer-speeds.keymap"

#define TEST_TAP(ROW, COL) ZMK_MOCK_PRESS(ROW, COL, 20) ZMK_MOCK_RELEASE(ROW, COL, 100)
#define TEST_PROBE TEST_TAP(0, 0)
#define TEST_CYCLE TEST_TAP(1, 3)
#define TEST_PRECISION_PRESS ZMK_MOCK_PRESS(1, 3, 250)
#define TEST_PRECISION_RELEASE ZMK_MOCK_RELEASE(1, 3, 100)
#define TEST_NAV_PRESS ZMK_MOCK_PRESS(0, 2, 250)
#define TEST_NAV_RELEASE ZMK_MOCK_RELEASE(0, 2, 100)
#define TEST_COMBO ZMK_MOCK_PRESS(0, 0, 1) ZMK_MOCK_PRESS(0, 1, 100) ZMK_MOCK_RELEASE(0, 1, 1) ZMK_MOCK_RELEASE(0, 0, 100)
#define TEST_SCROLL_PRESS ZMK_MOCK_PRESS(0, 1, 250)
#define TEST_SCROLL_RELEASE ZMK_MOCK_RELEASE(0, 1, 100)
#define TEST_ENTER_PRESS ZMK_MOCK_PRESS(3, 0, 250)
#define TEST_ENTER_RELEASE ZMK_MOCK_RELEASE(3, 0, 100)
#define TEST_SPACE_PRESS ZMK_MOCK_PRESS(3, 1, 250)
#define TEST_SPACE_RELEASE ZMK_MOCK_RELEASE(3, 1, 100)
#define TEST_PAD_UP TEST_TAP(2, 0)
#define TEST_CAPS_TOGGLE ZMK_MOCK_PRESS(3, 2, 20) ZMK_MOCK_RELEASE(3, 2, 40) ZMK_MOCK_PRESS(3, 2, 20) ZMK_MOCK_RELEASE(3, 2, 700)

&kscan {
    rows = <4>;
    columns = <4>;
    events = <
        ZMK_MOCK_PRESS(0,2,1)
        ZMK_MOCK_PRESS(0,0,1)
        ZMK_MOCK_RELEASE(0,0,1)
        ZMK_MOCK_RELEASE(0,2,1)
        ZMK_MOCK_PRESS(0,3,1)
        ZMK_MOCK_PRESS(0,0,1)
        ZMK_MOCK_RELEASE(0,3,1)
        ZMK_MOCK_RELEASE(0,0,1)
        ZMK_MOCK_PRESS(1,0,1)
        ZMK_MOCK_PRESS(0,0,1)
        ZMK_MOCK_RELEASE(0,0,1)
        ZMK_MOCK_RELEASE(1,0,1)
        ZMK_MOCK_PRESS(1,1,1)
        ZMK_MOCK_PRESS(0,0,1)
        ZMK_MOCK_RELEASE(0,0,1)
        ZMK_MOCK_RELEASE(1,1,250)
        ZMK_MOCK_PRESS(0,1,190)
        ZMK_MOCK_RELEASE(0,1,250)
        ZMK_MOCK_PRESS(0,1,210)
        ZMK_MOCK_RELEASE(0,1,250)
        ZMK_MOCK_PRESS(0,1,10)
        ZMK_MOCK_RELEASE(0,1,10)
        ZMK_MOCK_PRESS(0,1,250)
        ZMK_MOCK_RELEASE(0,1,250)
        ZMK_MOCK_PRESS(1,3,210)
        ZMK_MOCK_RELEASE(1,3,300)
        ZMK_MOCK_PRESS(1,3,230)
        ZMK_MOCK_PRESS(0,0,1)
        ZMK_MOCK_RELEASE(0,0,1)
        ZMK_MOCK_RELEASE(1,3,300)
        ZMK_MOCK_PRESS(0,2,1)
        ZMK_MOCK_PRESS(1,2,1)
        ZMK_MOCK_RELEASE(1,2,1)
        ZMK_MOCK_RELEASE(0,2,1)
        ZMK_MOCK_PRESS(0,0,1)
        ZMK_MOCK_RELEASE(0,0,100)
        ZMK_MOCK_PRESS(1,3,1)
        ZMK_MOCK_RELEASE(1,3,1)
        ZMK_MOCK_PRESS(0,0,1)
        ZMK_MOCK_RELEASE(0,0,1)
        ZMK_MOCK_PRESS(1,1,1)
        ZMK_MOCK_PRESS(1,2,1)
        ZMK_MOCK_RELEASE(1,2,1)
        ZMK_MOCK_RELEASE(1,1,1)
        ZMK_MOCK_PRESS(0,0,1)
        ZMK_MOCK_RELEASE(0,0,1)
        ZMK_MOCK_PRESS(0,0,1)
        ZMK_MOCK_RELEASE(0,0,100)

        TEST_NAV_PRESS
        TEST_PROBE
        TEST_CYCLE
        TEST_PROBE
        TEST_NAV_RELEASE
        TEST_PROBE
        TEST_TAP(1, 3)
        TEST_NAV_PRESS
        TEST_PROBE
        TEST_CYCLE
        TEST_PROBE
        TEST_COMBO
        TEST_NAV_RELEASE
        TEST_COMBO
        TEST_PROBE
        TEST_NAV_PRESS
        TEST_PROBE
        TEST_CYCLE
        TEST_PROBE
        TEST_CYCLE
        TEST_PROBE
        ZMK_MOCK_PRESS(1, 0, 100)
        TEST_PROBE
        TEST_COMBO
        ZMK_MOCK_RELEASE(1, 0, 100)
        TEST_PROBE
        TEST_TAP(1, 2)
        TEST_PROBE
        TEST_TAP(1, 3)
        TEST_NAV_RELEASE
        TEST_PROBE
        TEST_NAV_PRESS
        TEST_PROBE
        TEST_CYCLE
        TEST_PROBE
        TEST_NAV_RELEASE
        ZMK_MOCK_PRESS(0, 2, 1)
        ZMK_MOCK_PRESS(0, 3, 1)
        ZMK_MOCK_PRESS(1, 3, 1)
        ZMK_MOCK_RELEASE(1, 3, 1)
        ZMK_MOCK_RELEASE(0, 3, 100)
        TEST_NAV_RELEASE
        TEST_PROBE

        TEST_NAV_PRESS
        TEST_PROBE
        TEST_PRECISION_PRESS
        TEST_PROBE
        TEST_COMBO
        TEST_PRECISION_RELEASE
        TEST_PROBE
        TEST_CYCLE
        TEST_PROBE
        TEST_PRECISION_PRESS
        TEST_PROBE
        TEST_PRECISION_RELEASE
        TEST_PROBE
        TEST_CYCLE
        TEST_PROBE
        TEST_PRECISION_PRESS
        TEST_PROBE
        TEST_PRECISION_RELEASE
        TEST_PROBE
        TEST_CYCLE
        TEST_PROBE
        TEST_NAV_RELEASE
        TEST_PROBE

        TEST_NAV_PRESS
        TEST_CYCLE
        TEST_PROBE
        TEST_PRECISION_PRESS
        TEST_PROBE
        TEST_NAV_RELEASE
        TEST_PROBE
        TEST_COMBO
        TEST_PRECISION_RELEASE
        TEST_PROBE
        TEST_NAV_PRESS
        TEST_PROBE
        TEST_PRECISION_PRESS
        TEST_PROBE
        TEST_TAP(1, 2)
        TEST_PROBE
        TEST_PRECISION_RELEASE
        TEST_PROBE
        TEST_TAP(1, 3)
        TEST_NAV_RELEASE
        TEST_NAV_PRESS
        TEST_PROBE
        TEST_NAV_RELEASE

        TEST_NAV_PRESS
        TEST_TAP(1, 1)
        ZMK_MOCK_PRESS(1, 1, 180)
        ZMK_MOCK_RELEASE(1, 1, 100)
        ZMK_MOCK_PRESS(1, 1, 5)
        ZMK_MOCK_RELEASE(1, 1, 100)
        ZMK_MOCK_PRESS(0, 3, 250)
        TEST_TAP(1, 1)
        ZMK_MOCK_RELEASE(0, 3, 100)
        TEST_NAV_RELEASE

        TEST_NAV_PRESS
        TEST_TAP(0, 1)
        TEST_PROBE
        TEST_TAP(2, 0)
        TEST_SCROLL_PRESS
        TEST_TAP(2, 0)
        TEST_TAP(2, 1)
        TEST_TAP(2, 2)
        TEST_TAP(2, 3)
        TEST_SCROLL_RELEASE
        TEST_TAP(2, 0)
        TEST_CYCLE
        TEST_TAP(2, 0)
        TEST_SCROLL_PRESS
        TEST_TAP(2, 0)
        TEST_NAV_RELEASE
        TEST_TAP(2, 3)
        TEST_SCROLL_RELEASE
        TEST_TAP(2, 0)
        TEST_NAV_PRESS
        TEST_CYCLE
        TEST_TAP(2, 0)
        TEST_SCROLL_PRESS
        TEST_PRECISION_PRESS
        TEST_TAP(2, 0)
        TEST_PRECISION_RELEASE
        TEST_TAP(2, 3)
        TEST_SCROLL_RELEASE
        TEST_TAP(2, 0)
        TEST_SCROLL_PRESS
        TEST_TAP(1, 2)
        TEST_SCROLL_RELEASE
        TEST_TAP(2, 0)
        TEST_TAP(1, 3)
        TEST_NAV_RELEASE

        TEST_TAP(3, 0)
        TEST_TAP(3, 1)
        ZMK_MOCK_PRESS(3, 1, 10)
        ZMK_MOCK_PRESS(0, 0, 20)
        ZMK_MOCK_RELEASE(0, 0, 20)
        ZMK_MOCK_RELEASE(3, 1, 100)
        TEST_ENTER_PRESS
        TEST_PAD_UP
        TEST_TAP(2, 1)
        TEST_TAP(2, 2)
        TEST_TAP(2, 3)
        TEST_ENTER_RELEASE
        TEST_PAD_UP
        TEST_SPACE_PRESS
        TEST_PAD_UP
        TEST_SPACE_RELEASE
        TEST_PAD_UP
        TEST_ENTER_PRESS
        TEST_SPACE_PRESS
        TEST_PAD_UP
        TEST_ENTER_RELEASE
        TEST_PAD_UP
        TEST_SPACE_RELEASE
        TEST_PAD_UP

        TEST_NAV_PRESS
        TEST_CYCLE
        TEST_PAD_UP
        TEST_SPACE_PRESS
        TEST_PAD_UP
        TEST_SPACE_RELEASE
        TEST_PAD_UP
        TEST_CYCLE
        TEST_SPACE_PRESS
        TEST_PAD_UP
        TEST_SPACE_RELEASE
        TEST_PAD_UP
        TEST_CYCLE
        TEST_SCROLL_PRESS
        TEST_ENTER_PRESS
        TEST_PAD_UP
        TEST_SCROLL_RELEASE
        TEST_PAD_UP
        TEST_ENTER_RELEASE
        TEST_PAD_UP
        TEST_SCROLL_PRESS
        TEST_ENTER_PRESS
        TEST_PAD_UP
        TEST_ENTER_RELEASE
        TEST_PAD_UP
        TEST_SCROLL_RELEASE
        TEST_PAD_UP
        TEST_PRECISION_PRESS
        TEST_SPACE_PRESS
        TEST_PAD_UP
        TEST_PRECISION_RELEASE
        TEST_PAD_UP
        TEST_SPACE_RELEASE
        TEST_PAD_UP
        TEST_PRECISION_PRESS
        TEST_SPACE_PRESS
        TEST_PAD_UP
        TEST_SPACE_RELEASE
        TEST_PAD_UP
        TEST_PRECISION_RELEASE
        TEST_PAD_UP
        TEST_ENTER_PRESS
        TEST_SPACE_PRESS
        TEST_TAP(1, 2)
        TEST_ENTER_RELEASE
        TEST_PAD_UP
        TEST_SPACE_RELEASE
        TEST_PAD_UP
        TEST_TAP(1, 3)
        TEST_NAV_RELEASE

        TEST_CAPS_TOGGLE
        TEST_PROBE
        TEST_TAP(1, 3)
        TEST_PROBE
        TEST_TAP(1, 3)
        TEST_TAP(1, 3)
        TEST_PROBE
        TEST_TAP(3, 3)
        TEST_PROBE
        ZMK_MOCK_PRESS(3, 2, 700)
        TEST_TAP(3, 3)
        ZMK_MOCK_RELEASE(3, 2, 400)
        TEST_PROBE
        TEST_CAPS_TOGGLE
        TEST_PROBE

        ZMK_MOCK_PRESS(3, 2, 20)
        ZMK_MOCK_RELEASE(3, 2, 40)
        ZMK_MOCK_PRESS(3, 2, 700)
        TEST_PROBE
        ZMK_MOCK_RELEASE(3, 2, 400)
        TEST_PROBE
        ZMK_MOCK_PRESS(3, 2, 700)
        TEST_PROBE
        ZMK_MOCK_RELEASE(3, 2, 400)
        TEST_PROBE
    >;
};
